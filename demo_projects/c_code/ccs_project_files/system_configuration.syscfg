/**
 * These arguments were used when this file was generated. They will be automatically applied on subsequent loads
 * via the GUI or CLI. Run CLI with '--help' for additional information on how to override these arguments.
 * @cliArgs --device "F28P65x" --part "F28P65x_256ZEJ" --package "256ZEJ" --context "CPU1" --product "C2000WARE@5.04.00.00"
 * @v2CliArgs --device "TMS320F28P659DK-Q1" --package "256ZEJ" --variant "TMS320F28P659DK8-Q1" --context "CPU1" --product "C2000WARE@5.04.00.00"
 * @versions {"tool":"1.25.0+4268"}
 */

/**
 * Write custom configuration values to the imported modules.
 */
const divider8       = system.clockTree["EPWMCLKDIV"];
divider8.divideValue = 1;
